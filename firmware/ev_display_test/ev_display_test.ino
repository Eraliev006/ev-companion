// =============================================================
//  E.V — тест дисплея
//  Цель: убедиться, что провода подключены правильно,
//  и увидеть первую анимацию — моргающие глаза.
// =============================================================

// #include подключает библиотеки — чужой готовый код.
#include <Wire.h>   // Wire — работа с шиной I2C (провода SDA и SCL)
#include <U8g2lib.h> // U8g2 — рисование на монохромных дисплеях

// --- Пины, к которым мы подключили провода ---------------------
// const = константа, значение не меняется во время работы.
const int PIN_SDA = 21; // зелёный провод
const int PIN_SCL = 22; // жёлтый провод

// --- Создаём объект "дисплей" ----------------------------------
// SH1106     — чип внутри дисплея
// 128X64     — размер в пикселях
// F          — "full buffer": вся картинка сначала рисуется в памяти,
//              потом одним махом отправляется на экран (без мерцания)
// HW_I2C     — используем аппаратный I2C модуль ESP32
// U8G2_R0    — без поворота экрана
// U8X8_PIN_NONE — у дисплея нет отдельного пина сброса
U8G2_SH1106_128X64_NONAME_F_HW_I2C display(U8G2_R0, U8X8_PIN_NONE, PIN_SCL, PIN_SDA);

// -----------------------------------------------------------------
// Сканер I2C: опрашивает все возможные адреса (1..126)
// и печатает те, где кто-то ответил.
// -----------------------------------------------------------------
void scanI2C() {
  Wire.begin(PIN_SDA, PIN_SCL);
  Serial.println("Сканирую шину I2C...");
  int found = 0;
  for (byte address = 1; address < 127; address++) {
    Wire.beginTransmission(address);       // "Эй, устройство с адресом X!"
    byte error = Wire.endTransmission();   // 0 = ответили, иначе тишина
    if (error == 0) {
      Serial.print("  Найдено устройство: 0x");
      Serial.println(address, HEX);         // печатаем в шестнадцатеричном виде
      found++;
    }
  }
  if (found == 0) {
    Serial.println("  Ничего не найдено. Проверь провода SDA/SCL/VCC/GND!");
  }
}

// -----------------------------------------------------------------
// Рисуем один кадр: глаза открыты или закрыты.
// -----------------------------------------------------------------
void drawFace(bool eyesOpen) {
  display.clearBuffer(); // стираем картинку в памяти

  // Координаты: (0,0) — левый верхний угол, x вправо, y вниз.
  if (eyesOpen) {
    // drawRBox(x, y, ширина, высота, радиус скругления)
    display.drawRBox(28, 12, 24, 30, 6); // левый глаз
    display.drawRBox(76, 12, 24, 30, 6); // правый глаз
  } else {
    // закрытые глаза — тонкие полоски
    display.drawBox(28, 26, 24, 3);
    display.drawBox(76, 26, 24, 3);
  }

  display.setFont(u8g2_font_6x10_tr); // маленький шрифт
  display.drawStr(56, 60, "E.V");     // подпись внизу по центру

  display.sendBuffer(); // отправляем готовую картинку на экран
}

// -----------------------------------------------------------------
// setup() выполняется ОДИН раз при включении платы.
// -----------------------------------------------------------------
void setup() {
  Serial.begin(115200); // скорость "разговора" с компьютером по USB
  delay(500);
  Serial.println();
  Serial.println("=== E.V просыпается ===");

  scanI2C();

  display.begin();               // включаем дисплей
  display.setContrast(255);      // максимальная яркость
  Serial.println("Дисплей запущен, рисую лицо.");
}

// -----------------------------------------------------------------
// loop() выполняется БЕСКОНЕЧНО, снова и снова.
// -----------------------------------------------------------------
void loop() {
  drawFace(true);                     // глаза открыты
  delay(random(2000, 4000));          // ждём 2–4 секунды (случайно — живее)

  drawFace(false);                    // моргнули
  delay(120);                         // моргание длится 0.12 секунды
}
